## drivers/adxl345/zephyr/Kconfig
```kconfig
# Copyright (c) 2019 Nordic Semiconductor
# SPDX-License-Identifier: Apache-2.0

config ADXL345
	bool "Accelerometer support"
```

## drivers/bme680/zephyr/Kconfig
```kconfig
# Copyright (c) 2019 Nordic Semiconductor
# SPDX-License-Identifier: Apache-2.0

config BME680
	bool "Temp/Gas/Hum sensor support"
```

## drivers/ultrasonic/zephyr/Kconfig
```kconfig
# Copyright (c) 2019 Nordic Semiconductor
# SPDX-License-Identifier: Apache-2.0

config ULTRASONIC
	bool "Distance sensor support"
```
